# ESP32C5_RADIO register map
Vendor: Espressif; Series: ESP32-C5; File version: 0.1
ESP32-C5 modem/radio registers owned by the radio drivers. This first stage publishes the IEEE 802.15.4 MAC aperture, its interrupt route and the modem ETM channels it programs, and the modem clock gates and resets of its vendor clock devices, the analog register I2C master the PHY drives, and Wi-Fi MAC register views derived from the reviewed ESP32-S31 model. Unknown fields are omitted.
Registers are 32-bit, read-write, no defined reset value unless marked. A register's access mark holds for its fields unless they carry their own. Offsets are from the block's base; lines under a group give offsets from that group; [hi:lo] are bit positions; {n}, {i} and the like mark numbered series; 'fields as' and 'values as' point back to an identical list; <NAME> marks a mode.

## Memory map
0x20800000 CLIC — The core-local interrupt controller of the hart that accesses it, as 32-bit words: each line's word holds its pending, enable, attribute and control bytes. Invariant: every vectored line is level-triggered, so a write of the word that changes its enable or control writes back the pending bit read without losing or inventing an interrupt (SOURCE: ESP_HAL_1F646C5_CLIC_LEVEL_LINES). INT_CONFIG holds the number of level bits of each line's control byte.
0x60008000 TIMG0_WDT — Timer group 0's main watchdog (MWDT0): only its configuration, feed and write-protect words; the timers and the RTC calibration words of the group are not part of this view.
0x60009000 TIMG1_WDT — Timer group 1's main watchdog (MWDT1): only its configuration, feed and write-protect words; the timers and the RTC calibration words of the group are not part of this view.
0x6000A000 SYSTIMER — The system timer's comparators: their enables in CONF, targets, modes, load strobes and interrupt enables; their acknowledgements are SYSTIMER_ACKNOWLEDGE. The counter latch of unit zero is the separate shared block SYSTIMER_COUNTER; unit one, the unit loads and the read-back registers are not described.
0x6000A004 SYSTIMER_COUNTER — The counter latch of system timer unit zero: the UPDATE strobe copies the counter into VALUE_HI and VALUE_LO and VALUE_VALID reports the copy done. Every context reads the counter, so this is a shared block: a strobe writes UPDATE alone and the values are read without a side effect.
0x6000A06C SYSTIMER_ACKNOWLEDGE — The comparators' interrupt acknowledgements. Each comparator's alarm handler strobes its own bit alone, from its own context, so this is a shared block of write-trigger strobes.
0x6000E000 APB_SARADC_RADIO — ESP32-C5 APB_SARADC field the PHY's power-detector initialization drives. Other fields remain absent and are preserved by every field transaction.
0x6000F000 USB_SERIAL_JTAG — USB Serial/JTAG controller: the CDC-ACM data FIFO, its configuration and the two interrupts of the serial endpoints. The JTAG side and the other interrupt sources are not described.
0x6000F000 USB_SERIAL_JTAG_PADS — USB Serial/JTAG pad configuration: the software override of the D+ and D- pull-ups and the pad enable.
0x60010000 INTERRUPT_CORE0 — The interrupt-matrix route words of core 0, one per peripheral source, by source number, ZB_MAC (source 12) included.
0x60010150 INTERRUPT_CORE0_STATUS — The pending state of every peripheral source at core 0's interrupt matrix. Every context polls it, so it is a shared block of side-effect-free reads.
0x60096000 PCR_RADIO — ESP32-C5 PCR fields the PHY drives: the SAR ADC and temperature-sensor clocks and one word the public header does not describe. Other fields remain absent and are preserved by every field transaction.
0x60096000 PCR_TIMG1 — Peripheral clock/reset registers: timer group 1's bus clock, reset and watchdog clock words.
0x60096000 PCR_UART0_CLOCK — Peripheral clock/reset registers: UART0's function clock, which the boot ROM prints through after a software reset.
0x600A0000 PHY_BASEBAND_CONFIG — ESP32-C5 PHY baseband configuration words recovered from complete pinned libphy leaves. Operation-derived fields keep UNKNOWN where no public documentation establishes their electrical meaning.
0x600A3000 MODEM_IEEE802154_OBSERVED — Sparse source-qualified word views in the existing owned MMIO aperture; individual meanings and side effects remain unknown.
0x600A3000 IEEE802154_MAC — Dedicated ESP32-C5 IEEE 802.15.4 MAC aperture at 0x600A3000. This selective foundation publishes only register geometry exercised by the pinned public common/chip LL accessors and separately cited board observations of implemented opaque bits. The public struct and register headers still carry TODO ZB-93 pending an authoritative regdesc CSV, so untouched DTM, timing, debug-selector and modem-sleep words remain deliberately absent and no reset values are claimed.
0x600A4000 MODEM_WIFI_MAC_OBSERVED — Sparse source-qualified word views in the existing owned MMIO aperture; individual meanings and side effects remain unknown.
0x600A4000 WIFI_MAC_BSSID_POLICY — Per-interface BSSID address and policy words used by scan and associated-STA receive filtering.
0x600A405C WIFI_MAC_INTERFACE_ADDRESS — Four interface-address pairs consumed by MAC receive filtering.
0x600A42B4 WIFI_MAC_STA_BEACON_FILTER — Station beacon-filter control word recovered from the complete enable and disable leaves. The three low bits are toggled together; individual hardware meanings remain unknown.
0x600A4404 WIFI_MAC_ERSU_ACK_RATE — Four byte lanes independently replaced by hal_he_set_ersu_ack_rate; no bit-level rate encoding is assigned. SOURCE: C5_LIBPP_ROM_ERSU_ACK_RATE.
0x600A4C40 WIFI_MAC_INTERRUPT — Wi-Fi MAC interrupt mask, masked status and write-to-clear aperture. The two complete hal_mac leaves independently prove the status and clear addresses. The recovered common FIQ and cold initializer prove the event-bit mapping and mask transaction used by the open ISR.
0x600A4C5C WIFI_MAC_TX_COMMON — Shared Wi-Fi CCA, timeout and completion state used by MAC transmit queues and the PHY-owned Wi-Fi CCA gate.
0x600A8800 MODEM_ETM — ESP32-C5 modem event-task matrix at MODEM_BASE + 0x8800. The public IEEE 802.15.4 driver names the channel-enable, set and clear words and the per-channel event/task pair at an eight-byte stride from 0x18, and programs channels zero and one. Other channels and identifiers remain absent and no reset values are claimed.
0x600A9C00 MODEM_SYSCON_RADIO — ESP32-C5 MODEM_SYSCON clock gates and resets at MODEM_BASE + 0x9C00 driven by the vendor modem clock devices of the IEEE 802.15.4 module (802154_MAC, BT_I154_COMMON_BB, ETM, BT_APB) and its MAC reset. Other fields remain absent and are preserved by every field transaction.
0x600AD800 MODEM_WIFI_MAC_POWER_OBSERVED — Sparse source-qualified word views in the existing owned MMIO aperture; individual meanings and side effects remain unknown.
0x600AD814 WIFI_MAC_STA_TSF_LOAD — Shared station TSF load and coherent snapshot transaction.
0x600AD830 WIFI_MAC_RTC_TIMER_UPDATE — Complete enabled path of hal_timer_update_by_rtc, reached from complete hal_init with enable one and the OS-adapter slow-clock calibration value.
0x600AD860 WIFI_MAC_AUX_TSF_CONTROL — SoftAP, NAN and broadcast-TWT TSF control words. Complete public leaves prove their addresses and exact enable/mode masks; unrelated bits and hardware transition rules remain unnamed.
0x600AD8B0 WIFI_MAC_POWER_INTERRUPT — WDEVPWR interrupt bank named by complete print_isr_regs. Complete hal_pwr_interrupt_get_event and hal_pwr_interrupt_clr_event independently prove the masked STATUS read and full-width CLEAR acknowledgement transaction. Complete TSF timer enable/disable leaves update the timer interrupt masks in ENABLE and clear stale events through CLEAR.
0x600AF000 MODEM_LPCON_SHARED_CLOCK — ESP32-C5 MODEM_LPCON clock gate at MODEM_BASE + 0xF000 driven by the vendor COEXIST modem clock device, and the power-state map of the analog I2C master clock. Other fields remain absent and are preserved by every field transaction.
0x600AF800 I2C_ANA_MST — ESP32-C5 analog register I2C master at MODEM_BASE + 0xF800: the two command hosts, the read-mask word and the host-selection field that the libphy analog-register leaves drive. Other fields remain absent and are preserved by every field transaction.
0x600B0000 PMU_RADIO — ESP32-C5 PMU fields that the PHY drives: the analog I2C power and reset controls of the RF blocks and the immediate BB I2C power tie. Other fields remain absent and are preserved by every field transaction.
0x600B0400 LP_CLKRST_RESET_CAUSE — Low-power clock/reset registers: the reset cause of the HP core. Firmware reads it after boot; the host reads it through JTAG after a power cycle.
0x600B1000 LP_AON_RADIO — ESP32-C5 LP_AON field the PHY's power-detector SAR initialization drives. Other fields remain absent and are preserved by every field transaction.
0x600B1C00 LP_WDT — The RTC watchdog (RWDT) of the low-power watchdog block: its configuration word and write protection. The super watchdog's words are the separate LP_WDT_SWD view.
0x600B1C00 LP_WDT_SWD — The super watchdog (SWD) of the low-power watchdog block: its configuration word and write protection.
0x600B2800 LPPERI_RNG — Low-power peripheral registers: the random number generator's clock gate, its sampling and timer configuration and its synchronized output.
0x600C5090 FROM_CPU_0 — Software interrupt line 0 (interrupt source FROM_CPU_INTR0): one level bit a store of one raises and a store of zero lowers. Wakers raise it from every context and the line's handler lowers it, so it is a shared block whose one register is stored whole.
0x600C5094 FROM_CPU_1 — Software interrupt line 1 (interrupt source FROM_CPU_INTR1): one level bit a store of one raises and a store of zero lowers. Wakers raise it from every context and the line's handler lowers it, so it is a shared block whose one register is stored whole.
0x600C5098 FROM_CPU_2 — Software interrupt line 2 (interrupt source FROM_CPU_INTR2): one level bit a store of one raises and a store of zero lowers. Wakers raise it from every context and the line's handler lowers it, so it is a shared block whose one register is stored whole.
0x600C509C FROM_CPU_3 — Software interrupt line 3 (interrupt source FROM_CPU_INTR3): one level bit a store of one raises and a store of zero lowers. Wakers raise it from every context and the line's handler lowers it, so it is a shared block whose one register is stored whole.

## Licence text in the file
MIT OR Apache-2.0
